## app/boards/arm/Oumuamua/Kconfig.board
```kconfig
# Oumuamua board configuration

# Copyright (c) 2021 Kagen Aeby (Kikokeyco)
# SPDX-License-Identifier: MIT

config BOARD_OUMUAMUA
	bool "Oumuamua"
	depends on SOC_NRF52840_QIAA
```

## app/boards/arm/Oumuamua/Kconfig.defconfig
```kconfig
# Copyright (c) 2020 Kagen Aeby (Kikokeyco)
# SPDX-License-Identifier: MIT

if BOARD_OUMUAMUA

config ZMK_KEYBOARD_NAME
	default "Oumuamua"

if USB

config USB_NRFX
	default y

config USB_DEVICE_STACK
	default y

endif # USB

config BT_CTLR
	default BT

config ZMK_BLE
	default y

config ZMK_USB
	default y
	
config ZMK_BATTERY_VOLTAGE_DIVIDER
	default n

config ZMK_BATTERY_NRF_VDDH
	default n	

config I2C
	default y

config SSD1306
	default y

config SSD1306_REVERSE_MODE
	default y



CONFIG_ZMK_RGB_UNDERGLOW=y
CONFIG_WS2812_STRIP=y




endif # BOARD_OUMUAMUA
```
